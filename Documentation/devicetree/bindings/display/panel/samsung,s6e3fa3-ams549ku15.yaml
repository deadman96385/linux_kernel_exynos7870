## Documentation/devicetree/bindings/sound/samsung,exynos7870-cod3026x.yaml
```yaml
# SPDX-License-Identifier: (GPL-2.0-only OR BSD-2-Clause)
%YAML 1.2
---
$id: http://devicetree.org/schemas/sound/samsung,exynos7870-cod3026x.yaml#
$schema: http://devicetree.org/meta-schemas/core.yaml#

title: Samsung Exynos7870 audio complex with COD3026X codec

maintainers:
  - Sean Hoyt <seanhoyt963@gmail.com>

description: |
  The Exynos7870 application-processor I2S interface feeds the on-chip S1402X
  audio mixer. The mixer routes and converts the stream before driving the
  COD3026X analog codec. The card also describes the board-level microphone,
  earpiece, speaker, and headset connections.

allOf:
  - $ref: sound-card-common.yaml#

properties:
  compatible:
    const: samsung,exynos7870-cod3026x

  cpu:
    type: object
    additionalProperties: false
    properties:
      sound-dai:
        maxItems: 1
        description: Exynos7870 application-processor I2S DAI.
    required:
      - sound-dai

  mixer:
    type: object
    additionalProperties: false
    properties:
      sound-dai:
        maxItems: 1
        description: S1402X application-processor DAI.
    required:
      - sound-dai

  codec:
    type: object
    additionalProperties: false
    properties:
      sound-dai:
        maxItems: 1
        description: COD3026X primary audio DAI.
    required:
      - sound-dai

required:
  - compatible
  - model
  - audio-routing
  - cpu
  - mixer
  - codec

unevaluatedProperties: false

examples:
  - |
    #include <dt-bindings/sound/samsung,s1402x.h>

    sound {
        compatible = "samsung,exynos7870-cod3026x";
        model = "Samsung Galaxy J7 Pro";

        audio-routing =
            "Headphone", "HPOUTLN",
            "Earpiece", "EPOUTN",
            "Speaker", "SPKOUTLN",
            "IN1L", "Main Mic",
            "Main Mic", "MICBIAS1",
            "IN2L", "Sub Mic",
            "Sub Mic", "MICBIAS1",
            "IN3L", "Headset Mic",
            "Headset Mic", "MICBIAS2";

        cpu {
            sound-dai = <&i2s0 0>;
        };

        mixer {
            sound-dai = <&s1402x S1402X_DAI_AP0>;
        };

        codec {
            sound-dai = <&cod3026x 0>;
        };
    };
```

## Documentation/devicetree/bindings/sound/samsung,s1402x.yaml
```yaml
# SPDX-License-Identifier: (GPL-2.0-only OR BSD-2-Clause)
%YAML 1.2
---
$id: http://devicetree.org/schemas/sound/samsung,s1402x.yaml#
$schema: http://devicetree.org/meta-schemas/core.yaml#

title: Samsung S1402X on-chip audio mixer

maintainers:
  - Sean Hoyt <seanhoyt963@gmail.com>

description: |
  The S1402X mixes and routes the serial audio paths in the Exynos7870
  display-audio block.  It exposes seven DAIs for the application processor,
  modem, Bluetooth, FM, and amplifier paths.  DAI indices are defined in
  dt-bindings/sound/samsung,s1402x.h.

properties:
  compatible:
    const: samsung,s1402x

  reg:
    maxItems: 1

  clocks:
    items:
      - description: Application-processor serial-audio bit-clock gate
      - description: Bluetooth serial-audio bit-clock gate
      - description: Modem serial-audio bit-clock gate
      - description: FM serial-audio bit-clock gate
      - description: Mixer functional system clock
      - description: Rate-programmable mixer source clock
      - description: DISPAUD APB register-interface clock
      - description: Shared DISPAUD audio-subsystem APB clock

  clock-names:
    items:
      - const: ap-bclk
      - const: bt-bclk
      - const: cp-bclk
      - const: fm-bclk
      - const: mixer
      - const: dout
      - const: apb
      - const: audio-apb

  resets:
    maxItems: 1

  reset-names:
    const: mixer

  power-domains:
    maxItems: 1

  samsung,pmu-syscon:
    $ref: /schemas/types.yaml#/definitions/phandle
    description:
      PMU syscon containing the Bluetooth/FM input-path selector and the
      Exynos7870 DISPAUD power controls used when no generic power domain is
      attached.

  samsung,bt-fm-combo:
    type: boolean
    description:
      Bluetooth and FM share one serial input, so FM uses the Bluetooth mux
      selection and pin state.

  samsung,bck4-mcko:
    type: boolean
    description:
      Route the mixer master clock rather than the normal bit clock to BCK4.

  '#sound-dai-cells':
    const: 1

required:
  - compatible
  - reg
  - clocks
  - clock-names
  - resets
  - reset-names
  - power-domains
  - samsung,pmu-syscon
  - '#sound-dai-cells'

allOf:
  - $ref: dai-common.yaml#

unevaluatedProperties: false

examples:
  - |
    #include <dt-bindings/clock/samsung,exynos7870-cmu.h>
    #include <dt-bindings/reset/samsung,exynos7870-dispaud.h>

    audio-mixer@14880000 {
        compatible = "samsung,s1402x";
        reg = <0x14880000 0x200>;
        clocks = <&cmu_dispaud CLK_GOUT_DISPAUD_CON_EXT2AUD_BCK_GPIO_I2S>,
                 <&cmu_dispaud CLK_GOUT_DISPAUD_CON_AUD_I2S_BCLK_BT_IN>,
                 <&cmu_dispaud CLK_GOUT_DISPAUD_CON_CP2AUD_BCK>,
                 <&cmu_dispaud CLK_GOUT_DISPAUD_CON_AUD_I2S_BCLK_FM_IN>,
                 <&cmu_dispaud CLK_GOUT_DISPAUD_MIXER_AUD_SYSCLK>,
                 <&cmu_dispaud CLK_DOUT_DISPAUD_MIXER>,
                 <&cmu_dispaud CLK_GOUT_DISPAUD_APB>,
                 <&cmu_dispaud CLK_GOUT_DISPAUD_APB_AUD>;
        clock-names = "ap-bclk", "bt-bclk", "cp-bclk", "fm-bclk", "mixer",
                      "dout", "apb", "audio-apb";
        resets = <&dispaud_reset EXYNOS7870_DISPAUD_RESET_MIXER>;
        reset-names = "mixer";
        power-domains = <&pd_dispaud>;
        samsung,pmu-syscon = <&pmu_system_controller>;
        #sound-dai-cells = <1>;
    };
```

## drivers/gnss/Kconfig
```kconfig
# SPDX-License-Identifier: GPL-2.0-only
#
# GNSS receiver configuration
#

menuconfig GNSS
	tristate "GNSS receiver support"
	help
	  Say Y here if you have a GNSS receiver (e.g. a GPS receiver).

	  To compile this driver as a module, choose M here: the module will
	  be called gnss.

if GNSS

config GNSS_SERIAL
	tristate

config GNSS_MTK_SERIAL
	tristate "Mediatek GNSS receiver support"
	depends on SERIAL_DEV_BUS
	select GNSS_SERIAL
	help
	  Say Y here if you have a Mediatek-based GNSS receiver which uses a
	  serial interface.

	  To compile this driver as a module, choose M here: the module will
	  be called gnss-mtk.

	  If unsure, say N.

config GNSS_EXYNOS7870
	tristate "Samsung Exynos7870 KEPLER GNSS support"
	depends on ARCH_EXYNOS || COMPILE_TEST
	depends on OF && MAILBOX && REMOTEPROC
	select MFD_SYSCON
	help
	  Say y or m here to support the KEPLER GNSS shared-memory transport
	  integrated in Exynos7870 SoCs. The device exposes the proprietary
	  KEPLER protocol through the GNSS character-device interface.

	  A userspace protocol service is required to produce NMEA data.

config GNSS_SIRF_SERIAL
	tristate "SiRFstar GNSS receiver support"
	depends on SERIAL_DEV_BUS
	help
	  Say Y here if you have a SiRFstar-based GNSS receiver which uses a
	  serial interface.

	  To compile this driver as a module, choose M here: the module will
	  be called gnss-sirf.

	  If unsure, say N.

config GNSS_UBX_SERIAL
	tristate "u-blox GNSS receiver support"
	depends on SERIAL_DEV_BUS
	select GNSS_SERIAL
	help
	  Say Y here if you have a u-blox GNSS receiver which uses a serial
	  interface.

	  To compile this driver as a module, choose M here: the module will
	  be called gnss-ubx.

	  If unsure, say N.

config GNSS_USB
	tristate "USB GNSS receiver support"
	depends on USB
	help
	  Say Y here if you have a GNSS receiver which uses a USB interface.

	  To compile this driver as a module, choose M here: the module will
	  be called gnss-usb.

	  If unsure, say N.

endif # GNSS
```
