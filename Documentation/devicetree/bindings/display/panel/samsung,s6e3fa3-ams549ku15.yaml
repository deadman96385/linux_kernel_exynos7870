## Documentation/devicetree/bindings/display/panel/samsung,s6e3fa3-ams549ku15.yaml
```yaml
# SPDX-License-Identifier: (GPL-2.0-only OR BSD-2-Clause)
%YAML 1.2
---
$id: http://devicetree.org/schemas/display/panel/samsung,s6e3fa3-ams549ku15.yaml#
$schema: http://devicetree.org/meta-schemas/core.yaml#

title: Samsung AMS549KU15 AMOLED panel with S6E3FA3 controller

maintainers:
  - Samsung SoC maintainers <linux-samsung-soc@vger.kernel.org>

description:
  The AMS549KU15 is a 5.5-inch 1080x1920 command-mode AMOLED panel made by
  Samsung Mobile Display. It uses an S6E3FA3 display controller and a four-lane
  MIPI DSI link.

allOf:
  - $ref: panel-common.yaml#

properties:
  compatible:
    const: samsung,s6e3fa3-ams549ku15

  reg:
    maxItems: 1

  vci-supply:
    description: 3.0 V analog supply

  vdd3-supply:
    description: 1.8 V I/O supply

required:
  - compatible
  - reg
  - reset-gpios
  - te-gpios
  - vci-supply
  - vdd3-supply

unevaluatedProperties: false

examples:
  - |
    #include <dt-bindings/gpio/gpio.h>

    dsi {
        #address-cells = <1>;
        #size-cells = <0>;

        panel@0 {
            compatible = "samsung,s6e3fa3-ams549ku15";
            reg = <0>;
            reset-gpios = <&gpd3 4 GPIO_ACTIVE_LOW>;
            te-gpios = <&gpe0 2 GPIO_ACTIVE_HIGH>;
            vci-supply = <&ldo29_reg>;
            vdd3-supply = <&ldo30_reg>;
        };
    };
```

## Documentation/devicetree/bindings/gnss/samsung,exynos7870-kepler-gnss.yaml
```yaml
# SPDX-License-Identifier: (GPL-2.0-only OR BSD-2-Clause)
%YAML 1.2
---
$id: http://devicetree.org/schemas/gnss/samsung,exynos7870-kepler-gnss.yaml#
$schema: http://devicetree.org/meta-schemas/core.yaml#

title: Samsung Exynos7870 KEPLER GNSS Shared-Memory Transport

maintainers:
  - Johan Hovold <johan@kernel.org>

properties:
  compatible:
    const: samsung,exynos7870-kepler-gnss

  memory-region:
    maxItems: 1
    description: Reserved region shared with the KEPLER remote processor.

  remoteproc:
    $ref: /schemas/types.yaml#/definitions/phandle
    description: Phandle to the KEPLER remote processor.

  mboxes:
    maxItems: 1

  mbox-names:
    items:
      - const: ipc

  samsung,mailbox-syscon:
    $ref: /schemas/types.yaml#/definitions/phandle
    description: Phandle to the GNSS mailbox shared registers.

required:
  - compatible
  - memory-region
  - remoteproc
  - mboxes
  - mbox-names
  - samsung,mailbox-syscon

additionalProperties: false

examples:
  - |
    gnss {
        compatible = "samsung,exynos7870-kepler-gnss";
        mbox-names = "ipc";
        mboxes = <&mailbox_gnss 2>;
        memory-region = <&gnss_mem>;
        remoteproc = <&kepler>;
        samsung,mailbox-syscon = <&mailbox_gnss>;
    };
```

## Documentation/devicetree/bindings/iio/light/ams,tmd3725.yaml
```yaml
# SPDX-License-Identifier: (GPL-2.0 OR BSD-2-Clause)
%YAML 1.2
---
$id: http://devicetree.org/schemas/iio/light/ams,tmd3725.yaml#
$schema: http://devicetree.org/meta-schemas/core.yaml#

title: ams TMD3725 ambient light, color, and proximity sensor

maintainers:
  - Linux IIO maintainers <linux-iio@vger.kernel.org>

description: |
  The TMD3725 combines clear, red, green, and blue ambient-light channels
  with an IR proximity sensor and integrated IR emitter.

  Datasheet:
    https://look.ams-osram.com/m/6a4d0816b7d3a4bf/original/TMD3725-ALS-Color-and-Proximity-Sensor-Module.pdf

allOf:
  - $ref: ../common.yaml#

properties:
  $nodename:
    pattern: '^light-sensor@[0-9a-f]+$'

  compatible:
    const: ams,tmd3725

  reg:
    maxItems: 1

  interrupts:
    maxItems: 1

  vdd-supply:
    description: Regulator providing the sensor core supply.

  vled-supply:
    description: Regulator providing power to the integrated IR emitter.

  proximity-near-level: true

  ams,lux-coefficients:
    $ref: /schemas/types.yaml#/definitions/uint32-array
    minItems: 4
    maxItems: 4
    description: |
      Signed 32-bit red, green, blue, and clear coefficients, in that order,
      used to compensate for the optical window. Each value has a scale of
      1000 and negative values use two's-complement encoding.

  ams,device-factor:
    $ref: /schemas/types.yaml#/definitions/uint32
    description: Device and glass attenuation factor used for lux conversion.
    minimum: 1
    default: 831

  ams,cct-coefficient:
    $ref: /schemas/types.yaml#/definitions/uint32
    description: Blue-to-red ratio coefficient used for color temperature.
    default: 4091

  ams,cct-offset:
    $ref: /schemas/types.yaml#/definitions/uint32
    description: Offset in kelvin added to the calculated color temperature.
    default: 227

  wakeup-source: true

required:
  - compatible
  - reg

additionalProperties: false

examples:
  - |
    #include <dt-bindings/interrupt-controller/irq.h>

    i2c {
        #address-cells = <1>;
        #size-cells = <0>;

        light-sensor@39 {
            compatible = "ams,tmd3725";
            reg = <0x39>;
            interrupt-parent = <&gpio0>;
            interrupts = <5 IRQ_TYPE_EDGE_FALLING>;
            vled-supply = <&vled_reg>;
            proximity-near-level = <55>;
            ams,lux-coefficients = <0xfffffcc2 1100 0xfffffb64 1000>;
            ams,device-factor = <925>;
            ams,cct-coefficient = <3521>;
            ams,cct-offset = <2095>;
        };
    };
...
```

## Documentation/devicetree/bindings/mailbox/samsung,exynos7870-mbox.yaml
```yaml
# SPDX-License-Identifier: (GPL-2.0-only OR BSD-2-Clause)
%YAML 1.2
---
$id: http://devicetree.org/schemas/mailbox/samsung,exynos7870-mbox.yaml#
$schema: http://devicetree.org/meta-schemas/core.yaml#

title: Samsung Exynos7870 Mailbox Controller

maintainers:
  - Tudor Ambarus <tudor.ambarus@linaro.org>

description:
  The Exynos7870 mailbox has 16 bidirectional doorbell channels and 64 shared
  32-bit registers. A channel number selects the matching outgoing doorbell
  and incoming interrupt bit. Clients may access the shared registers through
  the syscon interface before ringing a doorbell.

properties:
  compatible:
    items:
      - const: samsung,exynos7870-mbox
      - const: syscon

  reg:
    maxItems: 1

  interrupts:
    description: Combined interrupt for the 16 incoming doorbells.
    maxItems: 1

  '#mbox-cells':
    const: 1
    description: Doorbell channel number from 0 through 15.

required:
  - compatible
  - reg
  - interrupts
  - '#mbox-cells'

additionalProperties: false

examples:
  - |
    #include <dt-bindings/interrupt-controller/arm-gic.h>

    mailbox@10570000 {
        compatible = "samsung,exynos7870-mbox", "syscon";
        reg = <0x10570000 0x180>;
        interrupts = <GIC_SPI 373 IRQ_TYPE_NONE>;
        #mbox-cells = <1>;
    };
```

## Documentation/devicetree/bindings/remoteproc/samsung,exynos7870-kepler.yaml
```yaml
# SPDX-License-Identifier: (GPL-2.0-only OR BSD-2-Clause)
%YAML 1.2
---
$id: http://devicetree.org/schemas/remoteproc/samsung,exynos7870-kepler.yaml#
$schema: http://devicetree.org/meta-schemas/core.yaml#

title: Samsung Exynos7870 KEPLER GNSS Processor

maintainers:
  - Tudor Ambarus <tudor.ambarus@linaro.org>

properties:
  compatible:
    const: samsung,exynos7870-kepler

  memory-region:
    maxItems: 1
    description:
      Reserved 4 MiB region containing 2 MiB for firmware followed by 2 MiB
      for the GNSS shared-memory transport.

  firmware-name:
    maxItems: 1

  mboxes:
    maxItems: 1

  mbox-names:
    items:
      - const: bcmd

  samsung,pmu-syscon:
    $ref: /schemas/types.yaml#/definitions/phandle
    description: Phandle to the Exynos PMU system controller.

  samsung,mailbox-syscon:
    $ref: /schemas/types.yaml#/definitions/phandle
    description: Phandle to the GNSS mailbox shared registers.

  interrupts:
    maxItems: 3

  interrupt-names:
    items:
      - const: active
      - const: watchdog
      - const: wakeup

required:
  - compatible
  - memory-region
  - firmware-name
  - mboxes
  - mbox-names
  - samsung,pmu-syscon
  - samsung,mailbox-syscon
  - interrupts
  - interrupt-names

additionalProperties: false

examples:
  - |
    #include <dt-bindings/interrupt-controller/arm-gic.h>

    remoteproc {
        compatible = "samsung,exynos7870-kepler";
        firmware-name = "samsung/exynos7870/gnss_firmware.bin";
        interrupts = <GIC_SPI 19 IRQ_TYPE_NONE>,
                     <GIC_SPI 478 IRQ_TYPE_NONE>,
                     <GIC_SPI 477 IRQ_TYPE_NONE>;
        interrupt-names = "active", "watchdog", "wakeup";
        mbox-names = "bcmd";
        mboxes = <&mailbox_gnss 0>;
        memory-region = <&gnss_mem>;
        samsung,mailbox-syscon = <&mailbox_gnss>;
        samsung,pmu-syscon = <&pmu_system_controller>;
    };
```

## Documentation/devicetree/bindings/reset/samsung,exynos7870-dispaud-reset.yaml
```yaml
# SPDX-License-Identifier: (GPL-2.0-only OR BSD-2-Clause)
%YAML 1.2
---
$id: http://devicetree.org/schemas/reset/samsung,exynos7870-dispaud-reset.yaml#
$schema: http://devicetree.org/meta-schemas/core.yaml#

title: Samsung Exynos7870 Display and Audio Reset Controller

maintainers:
  - Krzysztof Kozlowski <krzk@kernel.org>

description:
  The Exynos7870 DISPAUD system register block contains one register with
  active-high software reset bits for the audio mixer, I2S, amplifier, and
  audio DMA controller.

properties:
  compatible:
    const: samsung,exynos7870-dispaud-reset

  reg:
    maxItems: 1

  '#reset-cells':
    const: 1

  reset-controller: true

required:
  - compatible
  - reg
  - '#reset-cells'

additionalProperties: false

examples:
  - |
    reset-controller@148f1000 {
        compatible = "samsung,exynos7870-dispaud-reset";
        reg = <0x148f1000 0x4>;
        #reset-cells = <1>;
    };
```

## Documentation/devicetree/bindings/reset/samsung,exynos7870-lpass-reset.yaml
```yaml
# SPDX-License-Identifier: (GPL-2.0-only OR BSD-2-Clause)
%YAML 1.2
---
$id: http://devicetree.org/schemas/reset/samsung,exynos7870-lpass-reset.yaml#
$schema: http://devicetree.org/meta-schemas/core.yaml#

title: Samsung Exynos7870 Low Power Audio Subsystem Reset Controller

maintainers:
  - Sean Hoyt <seanhoyt963@gmail.com>

description:
  The Exynos7870 LPASS core software reset register contains active-low reset
  bits for the audio DMA, memory, timer, I2S, PCM, UART, and Slimbus blocks.

properties:
  compatible:
    const: samsung,exynos7870-lpass-reset

  reg:
    maxItems: 1

  '#reset-cells':
    const: 1

  reset-controller: true

required:
  - compatible
  - reg
  - '#reset-cells'

additionalProperties: false

examples:
  - |
    reset-controller@148f0008 {
        compatible = "samsung,exynos7870-lpass-reset";
        reg = <0x148f0008 0x4>;
        #reset-cells = <1>;
    };
```

## Documentation/devicetree/bindings/sound/samsung,cod3026x.yaml
```yaml
# SPDX-License-Identifier: (GPL-2.0-only OR BSD-2-Clause)
%YAML 1.2
---
$id: http://devicetree.org/schemas/sound/samsung,cod3026x.yaml#
$schema: http://devicetree.org/meta-schemas/core.yaml#

title: Samsung COD3026X audio codec

maintainers:
  - Sean Hoyt <seanhoyt963@gmail.com>

description: |
  COD3026X is a low-power stereo codec with three microphone inputs,
  headphone, earpiece and speaker outputs, and headset/button detection.

allOf:
  - $ref: dai-common.yaml#

properties:
  compatible:
    const: samsung,cod3026x

  reg:
    maxItems: 1

  interrupts:
    maxItems: 1

  vdd-supply:
    description: Codec analog and digital supply.

  io-channels:
    maxItems: 1
    description: ADC channel used for headset microphone and button detection.

  io-channel-names:
    const: jack

  samsung,mic-bias1-microvolt:
    enum: [2600000, 2800000, 3000000]
    default: 3000000

  samsung,mic-bias2-microvolt:
    enum: [2600000, 2800000, 3000000]
    default: 3000000

  samsung,mic-bias-ldo-microvolt:
    enum: [2500000, 2800000, 3000000, 3300000]
    default: 3300000

  samsung,mic-detect-threshold:
    $ref: /schemas/types.yaml#/definitions/uint32
    description:
      Raw ADC threshold separating three-pole headphones from four-pole
      headsets. Values below the threshold indicate a microphone.
    default: 1120

  samsung,mic-detect-delay-ms:
    description: Delay before sampling the ADC after headset insertion.
    default: 550

  samsung,button-release-threshold:
    $ref: /schemas/types.yaml#/definitions/uint32
    description: Raw ADC value at or above which all headset buttons are up.
    default: 1100

  samsung,button-press-delay-ms:
    description: Delay before sampling the ADC after a button interrupt.
    default: 30

  samsung,headset-button-zones:
    $ref: /schemas/types.yaml#/definitions/uint32-matrix
    description: |
      Headset button zones. Each row contains the Linux key code followed by
      the inclusive low and high raw ADC values for that button.
    minItems: 1
    maxItems: 4
    items:
      minItems: 3
      maxItems: 3

  '#sound-dai-cells':
    const: 0

required:
  - compatible
  - reg
  - interrupts
  - vdd-supply
  - '#sound-dai-cells'

dependencies:
  io-channel-names: [io-channels]
  samsung,headset-button-zones: [io-channels]
  samsung,mic-detect-threshold: [io-channels]

unevaluatedProperties: false

examples:
  - |
    #include <dt-bindings/i2c/i2c.h>
    #include <dt-bindings/interrupt-controller/irq.h>

    i2c {
        #address-cells = <1>;
        #size-cells = <0>;

        audio-codec@80000004 {
            compatible = "samsung,cod3026x";
            reg = <(I2C_TEN_BIT_ADDRESS | 0x04)>;
            interrupt-parent = <&gpa0>;
            interrupts = <4 IRQ_TYPE_LEVEL_LOW>;
            vdd-supply = <&ldo25>;
            io-channels = <&adc 2>;
            io-channel-names = "jack";
            samsung,mic-bias1-microvolt = <2800000>;
            samsung,mic-bias2-microvolt = <2800000>;
            samsung,mic-bias-ldo-microvolt = <3300000>;
            samsung,mic-detect-threshold = <1390>;
            samsung,mic-detect-delay-ms = <550>;
            samsung,headset-button-zones =
                <226 0 275>,
                <582 276 356>,
                <115 357 562>,
                <114 563 1000>;
            #sound-dai-cells = <0>;
        };
    };
```
